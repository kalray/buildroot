## configs/kvx_defconfig
```kconfig
BR2_kvx=y
BR2_TOOLCHAIN_BUILDROOT_WCHAR=y
BR2_TOOLCHAIN_BUILDROOT_CXX=y
BR2_PACKAGE_GMP=y
BR2_LINUX_KERNEL=y
BR2_LINUX_KERNEL_CUSTOM_TARBALL=y
BR2_LINUX_KERNEL_CUSTOM_TARBALL_LOCATION="$(call github,kalray,linux_coolidge,825912fbb11028643ec155c581c5ef8aec0d46d5)/linux-825912fbb11028643ec155c581c5ef8aec0d46d5.tar.gz"
BR2_PACKAGE_DTC=y
BR2_PACKAGE_DTC_PROGRAMS=y
BR2_TARGET_ROOTFS_INITRAMFS=y
# BR2_TARGET_ROOTFS_TAR is not set
BR2_PACKAGE_COREUTILS=y
BR2_PACKAGE_OPEN_LLDP=y
BR2_LINUX_KERNEL_USE_ARCH_DEFAULT_CONFIG=y
BR2_LINUX_KERNEL_DTS_SUPPORT=y
BR2_LINUX_KERNEL_INTREE_DTS_NAME="coolidge-qemu"
BR2_BINUTILS_VERSION_KVX=y
BR2_BINUTILS_VERSION="36c6e9ec960aa92a8b41b97fe5facd9a9abbb039"
BR2_GCC_VERSION_KVX=y
BR2_GCC_VERSION="ff559b8c1afd7b42a727268f56f544b819f65e04"
BR2_UCLIBC_VERSION_KVX=y
BR2_KALRAY_SITE=""
```

## package/binutils/Config.in.host
```kconfig
comment "Binutils Options"

config BR2_PACKAGE_HOST_BINUTILS_SUPPORTS_CFI
	bool
	default y
	depends on !BR2_microblaze

config BR2_PACKAGE_BINUTILS_HAS_NO_LIBSFRAME
	bool

choice
	prompt "Binutils Version"
	default BR2_BINUTILS_VERSION_2_40_X if !BR2_arc
	default BR2_BINUTILS_VERSION_ARC if BR2_arc
	default BR2_BINUTILS_VERSION_KVX if BR2_kvx
	help
	  Select the version of binutils you wish to use.

config BR2_BINUTILS_VERSION_2_39_X
	bool "binutils 2.39"
	select BR2_PACKAGE_BINUTILS_HAS_NO_LIBSFRAME

config BR2_BINUTILS_VERSION_2_40_X
	bool "binutils 2.40"

config BR2_BINUTILS_VERSION_2_41_X
	bool "binutils 2.41"

config BR2_BINUTILS_VERSION_ARC
	bool "binutils arc (2.34.50)"
	depends on BR2_arc
	select BR2_PACKAGE_BINUTILS_HAS_NO_LIBSFRAME

config BR2_BINUTILS_VERSION_KVX
	bool "binutils kvx"
	depends on BR2_kvx

config BR2_BINUTILS_CUSTOM_VERSION
	bool "binutils custom"

endchoice

config BR2_BINUTILS_CUSTOM_VERSION_VALUE
	string "Binutils version"
	depends on BR2_BINUTILS_CUSTOM_VERSION

config BR2_BINUTILS_VERSION
	string
	default BR2_BINUTILS_CUSTOM_VERSION_VALUE if BR2_BINUTILS_CUSTOM_VERSION
	default "arc-2020.09-release"	if BR2_BINUTILS_VERSION_ARC
	default "2.39"		if BR2_BINUTILS_VERSION_2_39_X
	default "2.40"		if BR2_BINUTILS_VERSION_2_40_X
	default "2.41"		if BR2_BINUTILS_VERSION_2_41_X
	default "36c6e9ec960aa92a8b41b97fe5facd9a9abbb039" if BR2_BINUTILS_VERSION_KVX

config BR2_BINUTILS_GPROFNG
	bool "gprofng support"
	depends on !BR2_BINUTILS_VERSION_ARC
	help
	  This option enables support for gprofng, a new profiler.

config BR2_BINUTILS_EXTRA_CONFIG_OPTIONS
	string "Additional binutils options"
	default ""
	help
	  Any additional binutils options you may want to include.
```

## package/musl/Config.in
```kconfig
config BR2_PACKAGE_MUSL_ARCH_SUPPORTS
	bool
	default y if BR2_aarch64
	default y if BR2_aarch64_be
	default y if BR2_arm
	default y if BR2_armeb
	default y if BR2_i386
	default y if BR2_microblaze
	default y if BR2_mips
	default y if BR2_mipsel
	default y if BR2_mips64
	default y if BR2_mips64el
	default y if BR2_or1k
	default y if BR2_powerpc
	default y if BR2_powerpc64
	default y if BR2_powerpc64le
	default y if BR2_RISCV_64
	default y if BR2_sh
	default y if BR2_x86_64
	depends on !BR2_powerpc_SPE # not supported, build breaks
	depends on !(BR2_powerpc64 || BR2_powerpc64le) || BR2_POWERPC_CPU_HAS_ALTIVEC
	# sh2 nommu is supported by musl, but we don't have support
	# for it in Buildroot.
	depends on BR2_USE_MMU

config BR2_PACKAGE_MUSL_SUPPORTS
	bool
	default y if BR2_PACKAGE_MUSL_ARCH_SUPPORTS

config BR2_PACKAGE_MUSL
	bool
	default y
	depends on BR2_TOOLCHAIN_USES_MUSL
	select BR2_PACKAGE_LINUX_HEADERS
	# SSP broken on i386/ppc: http://www.openwall.com/lists/musl/2016/12/04/2
	select BR2_TOOLCHAIN_HAS_SSP if BR2_PACKAGE_HOST_BINUTILS_SUPPORTS_CFI \
		&& !(BR2_i386 || BR2_powerpc)
	# Compatibility headers: cdefs.h, queue.h
	select BR2_PACKAGE_MUSL_COMPAT_HEADERS
	help
	  http://musl.libc.org/
choice
	prompt "Musl Version"
	default BR2_MUSL_VERSION_1_2_4
	default BR2_MUSL_VERSION_KVX if BR2_kvx
	help
	  Select the version of binutils you wish to use.

config BR2_MUSL_VERSION_1_2_4
	bool "musl 1.2.4"

config BR2_MUSL_VERSION_KVX
	bool "musl kvx"
	depends on BR2_kvx

config BR2_MUSL_CUSTOM_VERSION
	bool "musl custom"

endchoice

config BR2_MUSL_CUSTOM_VERSION_VALUE
	string "musl version"
	depends on BR2_MUSL_CUSTOM_VERSION

config BR2_MUSL_VERSION
	string
	default BR2_MUSL_CUSTOM_VERSION_VALUE if BR2_MUSL_CUSTOM_VERSION
	default "e3fa678e75994559b26d543705b93069345892ed" if BR2_MUSL_VERSION_KVX
	default "1.2.3" if BR2_MUSL_VERSION_1_2_3
```

## package/rauc/Config.in
```kconfig
config BR2_PACKAGE_RAUC
	bool "rauc"
	depends on BR2_TOOLCHAIN_HAS_THREADS # glib2
	depends on BR2_USE_MMU # glib2
	depends on BR2_USE_WCHAR # glib2
	select BR2_PACKAGE_LIBGLIB2
	select BR2_PACKAGE_OPENSSL
	select BR2_PACKAGE_SQUASHFS # run-time dependency
	select BR2_PACKAGE_UBOOT_TOOLS if BR2_TARGET_UBOOT # run-time dependency
	select BR2_PACKAGE_UBOOT_TOOLS_FWPRINTENV if BR2_TARGET_UBOOT
	help
	  RAUC is the Robust Auto-Update Controller developed by
	  Pengutronix. It supports updating embedded Linux
	  systems over the network or from disks and provides a
	  d-bus interface.

	  http://rauc.io/

if BR2_PACKAGE_RAUC

config BR2_PACKAGE_RAUC_DBUS
	bool "dbus support"
	select BR2_PACKAGE_DBUS
	help
	  This option enables support for controlling rauc through
	  D-Bus.

config BR2_PACKAGE_RAUC_GPT
	bool "GPT support"
	select BR2_PACKAGE_UTIL_LINUX
	select BR2_PACKAGE_UTIL_LINUX_LIBS
	select BR2_PACKAGE_UTIL_LINUX_LIBFDISK
	help
	    This option enables support for GPT partition tables.
choice
	prompt "RAUC Version"
	default BR2_RAUC_VERSION_KVX if BR2_kvx
	help
	  Select the version of rauc you wish to use.

config BR2_RAUC_VERSION_KVX
	bool "RAUC KVX"
	depends on BR2_kvx

config BR2_RAUC_CUSTOM_VERSION
	bool "Custom version"
	help
	  This option allows to use a specific official versions

endchoice

config BR2_RAUC_CUSTOM_VERSION_VALUE
	string "RAUC version"
	depends on BR2_RAUC_CUSTOM_VERSION

config BR2_RAUC_VERSION
	string
	default BR2_RAUC_CUSTOM_VERSION_VALUE if BR2_RAUC_CUSTOM_VERSION
	default "19f3bb2e38be375d5febfbf6e517623a3da5d703" if BR2_RAUC_VERSION_KVX
	default "1.10"

config BR2_PACKAGE_RAUC_NETWORK
	bool "network support"
	select BR2_PACKAGE_LIBCURL
	help
	  This option enables support for updating firmware over
	  the network using libcurl.

if BR2_PACKAGE_RAUC_NETWORK

config BR2_PACKAGE_RAUC_STREAMING
	bool "streaming update support"
	select BR2_PACKAGE_LIBNL
	help
	  This option enables support for streaming update mode.

endif

config BR2_PACKAGE_RAUC_JSON
	bool "JSON output support"
	select BR2_PACKAGE_JSON_GLIB
	help
	  This option enables support for providing output in
	  JSON format.

endif

comment "rauc needs a toolchain w/ wchar, threads"
	depends on !BR2_USE_WCHAR || !BR2_TOOLCHAIN_HAS_THREADS
	depends on BR2_USE_MMU
```
